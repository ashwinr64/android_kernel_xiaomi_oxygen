/*
 * Copyright (c) 2015-2018, The Linux Foundation. All rights reserved.
 *
 * This program is free software; you can redistribute it and/or modify
 * it under the terms of the GNU General Public License version 2 and
 * only version 2 as published by the Free Software Foundation.
 *
 * This program is distributed in the hope that it will be useful,
 * but WITHOUT ANY WARRANTY; without even the implied warranty of
 * MERCHANTABILITY or FITNESS FOR A PARTICULAR PURPOSE.  See the
 * GNU General Public License for more details.
 */

&pm8953_l22 {
    regulator-min-microvolt = <2850000>;
    regulator-max-microvolt = <2850000>;
    qcom,init-voltage = <2850000>;
};

&soc {
    /delete-node/ eldo2;

    fp_vdd_vreg: fp_vdd_vreg {
		compatible = "regulator-fixed";
		regulator-name = "fp_vdd_vreg";
		startup-delay-us = <4000>;
		enable-active-high;
		gpio = <&tlmm 139 0>;
	};
};
